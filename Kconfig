## Kconfig
```kconfig
menu "CardenzaHAL"

    config CARDENZA_HAL_APP_NAME
        string "This firmware's folder on the SD card: /sdcard/Apps/<name> (empty: the CMake project's name)"
        default ""
        help
            Every firmware on CardenzaHAL keeps its files on the SD card in a folder of its own,
            /sdcard/Apps/<name> (storage/app_dir.h, docs/SD-CARD.md); the 203 Launcher keeps its own in
            /sdcard/Launcher. Empty, the name is the app description's project name (CMake's project()).
            Either way it is made a safe FAT folder name: ASCII letters, digits, '-', '_' and '.', every
            other character '_', at most 31 characters. Choose it once: a firmware that renames its folder
            moves its users' files with CardenzaHAL::Storage::MigrateAppDir.

    config CARDENZA_HAL_DISPLAY_SPI_MHZ
        int "The display's SPI clock (MHz)"
        range 10 80
        default 80
        help
            The ST7789 panel's SPI clock; the chip makes 80, 40, 26.7, 20 MHz... from its 80 MHz APB clock and
            takes the nearest. At 80 MHz, the 203 Launcher's on every Cardenza, the HAL moves a whole frame
            in about 8 ms; at 40 MHz (the HAL's until 2026-11-23) a frame took about as long as the panel takes
            to scan it out, so the write ran beside the scan and moving pictures tore in steps (203-launcher
            docs/UX_REVIEW_2026-11-04.md). Lower it only to rule the clock out on a board whose screen
            misbehaves (docs/DISPLAY.md).

    config CARDENZA_HAL_SYSTEM_MENU
        bool "System menu: press HOME (back to the Launcher, restart, turn off)"
        default y
        help
            CardenzaHAL::Init starts the system menu (system/menu.h): a press of the side key (HOME,
            GPIO0) opens a menu drawn like the 203 Launcher's over the firmware, with Continue, Settings
            (the board's settings, system/settings.h), Back to Launcher, Restart, Turn off, About this
            device and Download mode. While it is open the firmware keeps running,
            but its frames are not sent, it sees no key and the key lights show the menu's keys.

            Costs: a task with a 3 KB stack that reads GPIO0 every 10 ms, about 10 KB of flash (words and
            glyphs); nothing else until the menu opens. At run time CardenzaHAL::SystemMenu::Enable(false)
            switches it off, for a firmware that needs HOME itself.

    menu "USB"

        config CARDENZA_HAL_USB_AUTOSTART
            bool "CardenzaHAL::Init starts USB (every firmware can be found and flashed over USB)"
            default y
            help
                CardenzaHAL::Init starts the USB device (usb/usb.h) with the default classes, so every firmware on
                the HAL can be recognised and sent into flashing by the 203 community's website and 203cli with
                no action from the person, also one that never calls USB::Init. A firmware that calls
                USB::Init(config) itself still chooses its classes: the HAL waits a second before it connects,
                so a firmware's own Init right after CardenzaHAL::Init is the only device the computer sees; a
                later one makes the computer find the device again with the new classes.

                Off: USB stays on the chip's USB-Serial-JTAG (the console and esptool's port) until the firmware
                calls USB::Init, as before 2026-11-24. For debugging over JTAG, or a firmware that needs the
                serial console of USB-Serial-JTAG.

        config CARDENZA_HAL_USB_MIDI
            bool "USB MIDI (carries the system channel as SysEx)"
            default y

        config CARDENZA_HAL_USB_AUDIO
            bool "USB audio, both ways (the computer records the device and plays to it)"
            default y

        config CARDENZA_HAL_USB_AUDIO_FEEDBACK
            bool "The computer's playback follows the device's clock (a feedback endpoint)"
            depends on CARDENZA_HAL_USB_AUDIO
            default y
            help
                With it the computer plays at the rate the device asks for (asynchronous with feedback). Without
                it the playback is adaptive: the computer plays by its own clock and the HAL keeps the FIFO
                level by dropping or repeating one frame now and then (a frame in 10,000 or fewer). It costs an
                IN endpoint: turn it off to make room for another class.

        config CARDENZA_HAL_USB_HID
            bool "USB HID (keyboard, media keys, gamepad, and the system channel as report 0xCB)"
            default y

        config CARDENZA_HAL_USB_WEBUSB
            bool "WebUSB (the system channel for web pages, on the control endpoint: no IN endpoint)"
            default y
            help
                A vendor interface with no endpoints: the system channel as control requests, with the WebUSB
                and Microsoft OS 2.0 descriptors (WinUSB on Windows without a driver; Chrome names the landing
                page below). Costs no IN endpoint and about 2 KB of flash.

        config CARDENZA_HAL_USB_WEBUSB_URL
            string "WebUSB landing page (https://, without the scheme)"
            depends on CARDENZA_HAL_USB_WEBUSB
            default "stage.203.io"

        config CARDENZA_HAL_USB_SERIAL
            bool "USB serial port (CDC: the console, the system channel as lines, esptool's reset)"
            default n
            help
                Added by the HAL anyway when the firmware has no MIDI, no HID and no WebUSB (a device always
                keeps a way to be recognised and flashed). Costs two IN endpoints.

        config CARDENZA_HAL_USB_DRIVE
            bool "USB drive: lend the SD card to the computer (USB::Drive)"
            default n
            help
                Builds USB mass storage for USB::Drive::Share() (usb/drive.h): the card lent to the computer as a
                removable disk. While it is lent the firmware's file system is unmounted (Storage::LentToComputer()),
                and the card comes back on Stop(), the computer's eject, the cable, or a host away for 10 s. The
                interface is there only while sharing (the computer finds the device again); its IN endpoint is
                taken from what gives way (usb/usb.h). About 4 KB of internal RAM for the class's buffer, and a task
                with a 6 KB stack while the card is lent. examples/usb_drive shows it.

        config CARDENZA_HAL_USB_NETWORK
            bool "USB network: the board as a network adapter (CDC-NCM; USB::Network)"
            default n
            help
                Builds a USB network interface (CDC-NCM, driverless on macOS, Linux and Windows 11) and its lwIP
                glue (usb/network.h): the device answers at a fixed address with its own DHCP server and mDNS
                (cardenza.local), or uses the computer's shared internet as a DHCP client. USB::Network::Start
                presents it (the computer finds the device again); its two IN endpoints are taken from what gives
                way. About 7 KB of internal RAM for its transfer blocks while the class is built.

        config CARDENZA_HAL_USB_CAMERA
            bool "USB camera: the screen as a lossless stream, for recording and streaming tutorials (USB::Camera)"
            depends on CARDENZA_HAL_USB_WEBUSB
            default n
            help
                Builds the screen stream (usb/camera.h): the device's screen, exact pixels, sent as the changed
                rectangles of each frame on a bulk endpoint of the WebUSB interface. A web page shows and records
                it (with the device's USB audio, a tutorial or a stream), and a desktop program can turn it into a
                virtual camera (protocol: docs/screen-stream.md). USB::Camera::Enable(true) presents it (the
                computer finds the device again); its IN endpoint is taken from what gives way. Nothing is sent
                and nothing is copied while no computer has the stream open.

    endmenu

    config CARDENZA_HAL_USB_DEV
        bool "Development channel over USB: a computer's questions about the firmware (203cli board)"
        default y
        help
            With USB started (USB::Init), the HAL answers a computer's questions about this firmware on its
            system channel (docs/usb-dev.md; the computer's side is 203cli board): what it is and how it was
            built, the partition table and how full it is, memory and tasks, the SD card, the I2C bus, a
            screenshot, its last crash (the core dump), keys pressed from the computer, and files on the card.

            Costs: nothing until a computer asks (no task, no buffer, no polling); about 20 KB of flash and
            0.4 KB of static internal RAM (measured on the template with USB started, 2026-11-20). A
            question starts a task of priority 1 with a 6 KB stack in internal RAM, deleted 10 s after the last
            one; a screenshot copies one frame at the firmware's next Present into PSRAM. Off, these questions
            are answered "off" and none of them is linked; the board's settings (203cli board settings) are
            answered either way.

    config CARDENZA_HAL_CRASH_LOOP_LAUNCHER
        bool "Back to the 203 Launcher after crashes in a row at start"
        default y
        help
            A firmware that crashes (panic or watchdog) within CARDENZA_HAL_CRASH_LOOP_SECONDS of its start
            this many times in a row is not started again: CardenzaHAL::Init restarts into the Launcher's home
            screen (its restart ticket), so a broken firmware never needs the BOOT key. A run that lasts longer
            clears the count; a power cycle too.

    config CARDENZA_HAL_CRASH_LOOP_CRASHES
        int "Crashes in a row"
        depends on CARDENZA_HAL_CRASH_LOOP_LAUNCHER
        range 2 10
        default 3

    config CARDENZA_HAL_CRASH_LOOP_SECONDS
        int "Seconds after the start in which a crash counts"
        depends on CARDENZA_HAL_CRASH_LOOP_LAUNCHER
        range 3 120
        default 15

    config CARDENZA_HAL_PRESENCE
        bool "Reachable from the 203 community while this firmware runs (presence service)"
        default y
        help
            CardenzaHAL::Init starts the community presence service (net/presence.h): on a board the
            203 Launcher bound to the community and connected to Wi-Fi, a task of priority 1 keeps Wi-Fi
            up and asks the community's inbox every 15 seconds with the device token (and the firmware's
            name, version and image digest), so the community shows the device online and what it runs,
            and firmware sent from the website (or the Launcher's own update) installs whatever this
            firmware is doing: the command is handed over to the Launcher (NVS l_pending) and the device
            restarts into it.

            It gives way to the firmware: Wi-Fi comes up only while the firmware's activity is Idle and
            its internal RAM floor stays free beside Wi-Fi (Presence::SetActivity, SetRamFloor), and is
            let go when the firmware says Quiet or runs short of RAM; no request starts while the
            speaker's DMA runs late.

            Costs, with it on (README.md, "Community presence", measured): Net is linked (about 22 KB of
            static internal RAM with the reference sdkconfig, examples/launcher_net/sdkconfig.defaults,
            about 34 KB without its .bss in PSRAM; about 610 KB of flash); on a bound board an 8 KB task
            stack and Wi-Fi's internal RAM while it is up (Presence::GetReport().wifiBytes), and per
            request a TLS connection (resumed after the first with CONFIG_ESP_TLS_CLIENT_SESSION_TICKETS).
            Off, nothing of it is linked. At run time CardenzaHAL::Presence::Enable(false) switches it off;
            a firmware that runs Wi-Fi itself must do that first (or turn this off).

    config CARDENZA_HAL_PRESENCE_START_DELAY
        int "Seconds after CardenzaHAL::Init before the presence service looks at the settings"
        depends on CARDENZA_HAL_PRESENCE
        range 0 600
        default 10
        help
            The firmware's own start (its RAM, its first screens) comes first.

    config CARDENZA_HAL_PRESENCE_LOCAL_HTTP
        bool "Debug only: let a test community on a loopback or private IPv4 address use http://"
        depends on CARDENZA_HAL_PRESENCE
        default n
        help
            The device token goes only over https to the community's own hosts (community.203.io,
            cardenza.203.io). This also allows http:// to 127.x, 10.x, 172.16-31.x and 192.168.x
            addresses, for a test community on the developer's network. Never in a build given to
            anyone: the token would cross the network in clear text.

endmenu
```
